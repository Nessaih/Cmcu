#include "led.h"


/********************************************************************************************
*  函 数 名： Led_Io_Init
*  描    述:  LED端口初始化
*  输入参数： 无   
*  输出参数： 无
*  返 回 值:  无
*  作    者:  秦浩
*  完成日期:  2018-07-18
*  注意事项:  无
********************************************************************************************/

void Led_Io_Init(void)
{
    /*PF6,PF9,PF10 配置成通用推挽输出模式*/
    RCC->AHB1ENR |= (0X01<<2)|(0X01<<5);        //开启PC.PF端口时钟
 
    GPIOF->MODER &= ~((0X03<<12)|(0X03<<18)|(0X03<<20));    //清零操作
    GPIOF->MODER |= (0X01<<12)|(0X01<<18)|(0X01<<20);       //通用输出模式
    GPIOF->OTYPER &= ~((0X01<<6)|(0X01<<9)|(0X01<<10));    //推挽模式
    GPIOF->OSPEEDR &= ~((0X03<<12)|(0X03<<18)|(0X03<<20));  //输出速度为2MHZ
    GPIOF->PUPDR &=  ~((0X03<<12)|(0X03<<18)|(0X03<<20));    //浮空模式
    GPIOF->ODR |= ((0X01<<6)|(0X01<<9)|(0X01<<10));       //输出低电平灯亮  
    
    GPIOC->MODER &= ~(0X03<<0);
    GPIOC->MODER |= 0X01<<0;
    GPIOC->OTYPER &= ~(0X01<<0);
    GPIOC->OSPEEDR &= ~(0X03<<0);
    GPIOC->PUPDR &= ~(0X03<<0);
    GPIOC->ODR |= (0X01<<0);
}


/********************************************************************************************
*  函 数 名： Led_state_control（uint8 Led_state）
*  描    述:  用低四位控制4个LED灯，高位控制第一个灯，依次类推
*  输入参数： Led_state
*  输出参数： 无
*  返 回 值:  无
*  作    者:  秦浩
*  完成日期:  2018-07-18
*  注意事项:  无
********************************************************************************************/

void Led_state_control(uint8 Led_state)
{
    if(Led_state &(0x01<<0))//控制第四个灯
    {
        PCout(0)=0;
    }
    else
    {
        PCout(0)=1;
    }
    if(Led_state &(0x01<<1))//控制第三个灯
    {
        PFout(10)=0;
    }
    else
    {
        PFout(10)=1;
    }
    
     if(Led_state &(0x01<<2))//控制第二个灯
    {
        PFout(9)=0;
    }
    else
    {
        PFout(9)=1;
    }
    
     if(Led_state &(0x01<<3))//控制第一个灯
    {
        PFout(6)=0;
    }
    else
    {
        PFout(6)=1;
    }
}




